## SDK_4_0_0_0/RT288x_SDK/source/linux-2.6.21.x/ralink/Kconfig
```kconfig
menu "Ralink Module"

###########
# Debuging
###########
source "drivers/net/rt_rdm/Kconfig"

#############
# Wire
#############
source "drivers/net/raeth/Kconfig"

#############
# Wireless
#############
menuconfig WIFI_DRIVER
	bool "WiFi Driver Support"

if WIFI_DRIVER

config  RT2860V2_2850
        bool "Dual Band"
        depends on RALINK_RT2880

choice
        prompt "RF Type"
        depends on RALINK_RT5350 
        default RALINK_RT5350_1T1R

        config  RALINK_RT5350_1T1R
        bool "1T1R"
endchoice

choice
        prompt "RF Type"
        depends on RALINK_RT3052
        default RALINK_RT3052_2T2R

        config  RALINK_RT3050_1T1R
        bool "1T1R"

        config  RALINK_RT3051_1T2R
        bool "1T2R"

        config  RALINK_RT3052_2T2R
        bool "2T2R"
endchoice

choice
        prompt "RF Type"
        depends on  RALINK_RT3352 

        config  RALINK_RT3352_2T2R
        bool "2T2R"
endchoice

choice
	prompt "RF Type"
	depends on RALINK_RT3883

	config  RALINK_RT3662_2T2R
	bool "2T3R (RT3662)"

	config  RALINK_RT3883_3T3R
	bool "3T3R (RT3883)"
endchoice

#source "drivers/net/wireless/rt2860v2_ap/Kconfig"
config  RT2860V2_AP_RF_OFFSET
	depends on RT2860V2_AP
	hex
	default 0x40000
config  RA_CLASSIFIER
	tristate "Ralink Flow Classifier"
	depends on RT2860V2_AP_VIDEO_TURBINE || RT2860V2_STA_VIDEO_TURBINE
	default n
#source "drivers/net/wireless/rt2860v2_sta/Kconfig"

#source "drivers/net/wireless/rt2860v2_apsta/Kconfig"
#source "drivers/net/wireless/RT3090_ap/Kconfig"
config  RT3090_AP_RF_OFFSET
	depends on RT3090_AP
	hex
	default 0x48000

#source "drivers/net/wireless/RT5392_ap/Kconfig"
config  RT5392_AP_RF_OFFSET
	depends on RT5392_AP
	hex
	default 0x48000

#source "drivers/net/wireless/RT5592_ap/Kconfig"
config  RT5592_AP_RF_OFFSET
	depends on RT5592_AP
	hex
	default 0x48000

#source "drivers/net/wireless/RT3593_ap/Kconfig"
config  RT3593_AP_RF_OFFSET
	depends on RT3593_AP
	hex
	default 0x48000

#source "drivers/net/wireless/RT3572_ap/Kconfig"
config  RT3572_AP_RF_OFFSET
	depends on RT3572_AP
	hex
	default 0x48000

#source "drivers/net/wireless/RT5572_ap/Kconfig"
config  RT5572_AP_RF_OFFSET
	depends on RT5572_AP
	hex
	default 0x48000

#source "drivers/net/wireless/iNIC/Kconfig"
#source "drivers/net/wireless/iNIC_RT305x/Kconfig"
#source "drivers/net/wireless/RT3680_ap/Kconfig"
config  RT3680_iNIC_AP_RF_OFFSET
	depends on RT3680_iNIC_AP
	hex
	default 0x48000

config RTDEV_MII
bool
default y if RT2880v2_INIC_MII || RT305x_INIC_MII || RT305x_INIC_USB || RT3680_iNIC_AP

config RTDEV
	bool
	depends on RT3090_AP || RT5392_AP || RT5592_AP || RT3593_AP || RT3572_AP || RT5572_AP || RTDEV_MII
	default y

#config  UNIQUE_WPS
#	bool "Unique WPS for Concurrent AP"
#        depends on RT2860V2_AP_WSC 
#        depends on RT3090_AP_WSC || RT3572_AP_WSC || RT5392_AP_WSC || RT5572_AP_WSC || RT5592_AP_WSC
#	default n
endif # WIFI_DRIVER

#######
# USB
#######
source "drivers/usb/dwc_otg/Kconfig"

#######
# NAT
#######
choice
prompt "Ralink NAT Type"

	
config  RA_NAT_NONE
bool "None"
config  RA_NAT_HW
bool "Hardware"
depends on !RALINK_RT5350
endchoice

source "net/nat/hw_nat/Kconfig"


endmenu
```

## SDK_4_0_0_0/RT288x_SDK/source/linux-2.6.36MT.x/arch/mips/ralink/Kconfig
```kconfig
if RALINK_RT63365

choice
        prompt "Soc Hardware Type"
	default RT63365_ASIC

config  RT63365_FPGA 
	bool "RT6855/6(63365)-FPGA"

config  RT63365_ASIC 
	bool "RT6855/6(63365)-ASIC"

endchoice

endif

config  KERNEL_NVRAM
	bool 'Kernel NVRAM' 
	default n

choice
       prompt "Flash Type"
       default MTD_ANY_RALINK

config MTD_NOR_RALINK
       bool "NOR"
       depends on  !RALINK_RT3352 && !RALINK_RT5350 && !RALINK_RT6855 && !RALINK_RT63365

config MTD_SPI_RALINK
       bool "SPI"
       depends on  !RALINK_RT2880

config MTD_NAND_RALINK
       bool "NAND"
       depends on  !RALINK_RT3352 && !RALINK_RT2880 && !RALINK_RT5350 && !RALINK_RT6855

config MTD_ANY_RALINK
       bool "ANY (NOR/SPI/NAND)"
       depends on  !RALINK_RT3352 && !RALINK_RT5350

endchoice


choice
	prompt "PCIe Setting"
	default RT63365_PCIE_PORT0_ENABLE

config  RT63365_PCIE_PORT0_ENABLE
        bool "Port0 ENABLE Port1 DISABLE(RT6855)"

config  RT63365_PCIE_PORT01_ENABLE
        bool "Port0&1 ENABLE(RT6856)"
endchoice

choice
	prompt "Root File System Type"
	default RT2880_ROOTFS_IN_RAM

config  RT2880_ROOTFS_IN_RAM
        bool "RootFS_in_RAM"
	select BLK_DEV_INITRD 
	select BLK_DEV_RAM 

config  RT2880_ROOTFS_IN_FLASH
        bool "RootFS_in_FLASH"
endchoice

config BLK_DEV_RAM_SIZE
	int 'Default RAM disk size'
	default 8192
	depends on RT2880_ROOTFS_IN_RAM

config	LZMARAMFS
	bool "Compress ramdisk by lzma instead of gzip"
	depends on RT2880_ROOTFS_IN_RAM

config ROOTFS_IN_FLASH_NO_PADDING
	bool 'No Padding between Kernel and RootFS'
	default n
	depends on RT2880_ROOTFS_IN_FLASH && !RT2880_FLASH_32M && !DUAL_IMAGE

config MTD_KERNEL_PART_SIZ
	hex 'MTD Kernel Partition Size (Unit:Bytes)'
	default 0xD0000
	depends on RT2880_ROOTFS_IN_FLASH && !ROOTFS_IN_FLASH_NO_PADDING
```

## SDK_4_0_0_0/RT288x_SDK/source/linux-2.6.36MT.x/ralink/Kconfig
```kconfig
menu "Ralink Module"

###########
# Debuging
###########
source "drivers/net/rt_rdm/Kconfig"

#############
# Wire
#############
source "drivers/net/raeth/Kconfig"

#############
# Wireless
#############
menuconfig WIFI_DRIVER
	bool "WiFi Driver Support"

if WIFI_DRIVER
choice
	prompt "Choose First WiFi Interface"
	config  1STIF_RTPCI
	bool "RTPCI"
	depends on RTPCI_AP
	config  1STIF_RT3090
	bool "RT3090"
	depends on RT3090_AP
	config  1STIF_RT5392
	bool "RT5392"
	depends on RT5392_AP
	config  1STIF_RT5592
	bool "RT5592"
	depends on RT5592_AP
	config  1STIF_RT3593
	bool "RT3593"
	depends on RT3593_AP
	config  1STIF_RT3572
	bool "RT3572"
	depends on RT3572_AP
	config  1STIF_RT5572
	bool "RT5572"
	depends on RT5572_AP
endchoice

#source "drivers/net/wireless/RTPCI_ap/Kconfig"
config  RTPCI_AP_RF_OFFSET
	depends on RTPCI_AP
	hex
	default 0x40000 if 1STIF_RTPCI
	default 0x48000 if !1STIF_RTPCI

#source "drivers/net/wireless/RT3090_ap/Kconfig"
config  RT3090_AP_RF_OFFSET
	depends on RT3090_AP
	hex
	default 0x40000 if 1STIF_RT3090
	default 0x48000 if !1STIF_RT3090

#source "drivers/net/wireless/RT5392_ap/Kconfig"
config  RT5392_AP_RF_OFFSET
	depends on RT5392_AP
	hex
	default 0x40000 if 1STIF_RT5392
	default 0x48000 if !1STIF_RT5392

#source "drivers/net/wireless/RT5592_ap/Kconfig"
config  RT5592_AP_RF_OFFSET
	depends on RT5592_AP
	hex
	default 0x40000 if 1STIF_RT5592
	default 0x48000 if !1STIF_RT5592

#source "drivers/net/wireless/RT3593_ap/Kconfig"
config  RT3593_AP_RF_OFFSET
	depends on RT3593_AP
	hex
	default 0x40000 if 1STIF_RT3593
	default 0x48000 if !1STIF_RT3593

#source "drivers/net/wireless/RT3572_ap/Kconfig"
config  RT3572_AP_RF_OFFSET
	depends on RT3572_AP
	hex
	default 0x40000 if 1STIF_RT3572
	default 0x48000 if !1STIF_RT3572

#source "drivers/net/wireless/RT5572_ap/Kconfig"
config  RT5572_AP_RF_OFFSET
	depends on RT5572_AP
	hex
	default 0x40000 if 1STIF_RT5572
	default 0x48000 if !1STIF_RT5572

config RTDEV
	bool
	depends on RT3090_AP || RT5392_AP || RT5592_AP || RT3593_AP || RT3572_AP || RT5572_AP || RTPCI_AP
	default y if RTPCI_AP
	default y if RT3090_AP && !1STIF_RT3090
	default y if RT5392_AP && !1STIF_RT5392
	default y if RT5592_AP && !1STIF_RT5592
	default y if RT3593_AP && !1STIF_RT3593
	default y if RT5592_AP_MULTIPLE_CARD || RT3593_AP_MULTIPLE_CARD
	default y if RT3572_AP && !1STIF_RT3572
	default y if RT5572_AP && !1STIF_RT5572
endif # WIFI_DRIVER

#######
# NAT
#######
choice
prompt "Ralink NAT Type"
	
config  RA_NAT_NONE
bool "None"
config  RA_NAT_HW
bool "Hardware"
endchoice

source "net/nat/hw_nat/Kconfig"

endmenu
```
